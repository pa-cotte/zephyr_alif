## drivers/audio/Kconfig.dmic_alif
```kconfig
# Copyright (c) 2024 Alif Semiconductor
#
# SPDX-License-Identifier: Apache-2.0
config ALIF_PDM
	bool "Alif PDM module driver enable"
	help
	  Enable Alif PDM module driver
```

## drivers/comparator/Kconfig.alif
```kconfig
# Copyright (C) 2024 Alif Semiconductor
# SPDX-License-Identifier: Apache-2.0

config CMP_ALIF
	bool "Enable ALif CMP driver"
	default y
	help
	  Enable driver for Alif CMP
```

## drivers/counter/Kconfig.dw
```kconfig
# Synopsys DesignWare Timer configuration option

# Copyright (c) 2023, Intel Corporation.
# SPDX-License-Identifier: Apache-2.0

config COUNTER_SNPS_DW
	bool "Synopsys DesignWare Timer Driver"
	default y
	depends on DT_HAS_SNPS_DW_TIMERS_ENABLED
	help
	  Enable Timer driver

config COUNTER_DW_RTC
	bool "Designware counter RTC driver"
	default y
	depends on DT_HAS_SNPS_DW_APB_RTC_ENABLED
	help
	  Enable counter driver for Designware RTC counter series. Such driver
	  will expose the basic RTC counter device present on the MCU.
```

## drivers/crc/Kconfig.crc
```kconfig
config CRC
	bool "Alif CRC"
	default y
	depends on DT_HAS_ALIF_ALIF_CRC_ENABLED
	help
	  Enable driver for Alif CRC
```

## drivers/display/Kconfig.cdc200
```kconfig
# Alif CDC200 display driver configuration options

# Copyright (C) 2024 Alif Semiconductor
# SPDX-License-Identifier: Apache-2.0

menuconfig CDC200
	bool "CDC200 driver"
	default y
	depends on DT_HAS_TES_CDC_2_1_ENABLED
	help
	  Enable support for CDC200 driver controller.
```

## drivers/flash/Kconfig.alif
```kconfig
# Copyright (c) 2024 Alif Semiconductor
#
# SPDX-License-Identifier: Apache-2.0
config MRAM_FLASH_ALIF
	bool "MRAM flash driver for Alif SoCs"
	default y
	depends on DT_HAS_ALIF_MRAM_FLASH_CONTROLLER_ENABLED
	select FLASH_HAS_DRIVER_ENABLED
	select FLASH_HAS_PAGE_LAYOUT
	help
	 Enables MRAM flash driver on Alif SoCs.

menuconfig OSPI_FLASH_IS25WX
	bool "OSPI Flash IS25WX 128/256/512 driver for Alif DevKit"
	default y
	depends on DT_HAS_ISSI_XSPI_FLASH_CONTROLLER_ENABLED
	select FLASH_HAS_DRIVER_ENABLED
	select FLASH_HAS_PAGE_LAYOUT
	help
	 Enables IS25WX256/512 flash driver on Alif DevKit.
	 Update num-of-sector@ospi_flash property value in devicetree.
	 - 8K for 256Mb and 16K for 512Mb size support.

if OSPI_FLASH_IS25WX
	config USE_ALIF_HAL_OSPI
	bool "OSPI driver located in HAL Module"
	default y
	help
	 Enables OSPI driver on Alif SoCs.

endif # OSPI_FLASH_IS25WX
```

## drivers/mipi_dphy/Kconfig.ensemble
```kconfig
# Alif MIPI-DPHY driver configuration options

# Copyright (C) 2024 Alif Semiconductor
# SPDX-License-Identifier: Apache-2.0

config MIPI_DPHY_ENSEMBLE
	bool "MIPI-DPHY Host Controller for Alif Ensemble"
	default y
	depends on DT_HAS_ALIF_ENSEMBLE_DPHY_ENABLED
	help
	  Enable Alif MIPI DPHY Host controller driver

if MIPI_DPHY_ENSEMBLE

config MIPI_DPHY_ENSEMBLE_INIT_PRIORITY
	int "Initialization priority"
	default 39
	help
	  MIPI-DPHY Host Controllers initialization priority.

endif
```

## drivers/mipi_dsi/Kconfig.ensemble
```kconfig
# Alif MIPI-DSI driver configuration options

# Copyright (C) 2024 Alif Semiconductor
# SPDX-License-Identifier: Apache-2.0

config MIPI_DSI_ENSEMBLE
	bool "MIPI-DSI Host Controller for Alif Ensemble"
	default y
	depends on DT_HAS_ALIF_ENSEMBLE_DSI_ENABLED
	select MIPI_DPHY
	help
	  Enable Alif MIPI DSI Host controller driver
```

## drivers/sdhc/Kconfig.alif
```kconfig
# Copyright (c) 2025 Alif Semiconductor
# SPDX-License-Identifier: Apache-2.0

config ALIF_SDIO
	bool "Alif SDIO driver"
	default y
	depends on DT_HAS_ALIF_SDIO_ENABLED
	select SDHC_SUPPORTS_NATIVE_MODE
	help
	  Enable support for Alif SDIO controller driver.
	  This driver supports SDIO protocol for general I/O functions 
	  on Alif microcontroller family.

if ALIF_SDIO

config SDHC_INIT_PRIORITY
	default 70
	
config ALIF_SDIO_INIT_PRIORITY
	int "Init priority"
	default KERNEL_INIT_PRIORITY_DEVICE
	help
	  Device driver initialization priority.
	  SDIO driver device must be initialized after the SD host controller.

config ALIF_SDIO_LOG_LEVEL
	int "Log level for Alif SDIO driver"
	depends on LOG
	range 0 4
	default 3
	help
	  Sets log level for Alif SDIO driver.
	  - 0: OFF
	  - 1: ERROR
	  - 2: WARNING
	  - 3: INFO
	  - 4: DEBUG

config ALIF_SDIO_CMD_RETRY
	int "Command retry count"
	default 3
	help
	  Number of times to retry failed SDIO commands.
	  Some cards may need retries during initialization.

config ALIF_SDIO_ENABLE_DMA
	bool "Enable DMA support"
	default y
	help
	  Enable DMA support for SDIO data transfers.
	  Disabling this option will use PIO mode instead.

endif # ALIF_SDIO
```

## drivers/video/Kconfig.ensemble
```kconfig
# Alif Camera controller driver configuration options

# Copyright (C) 2024 Alif Semiconductor
# SPDX-License-Identifier: Apache-2.0

config VIDEO_ENSEMBLE_CAM
	bool "Ensemble Camera Parallel Interface (CPI) controller driver"
	default y
	depends on DT_HAS_ALIF_ENSEMBLE_CAM_ENABLED

if VIDEO_ENSEMBLE_CAM

config VIDEO_ENSEMBLE_CAM_INIT_PRIORITY
	int "CPI Video initialization priority"
	default 61
	help
	  System initialization priority for Ensemble Camera Driver.

endif #VIDEO_ENSEMBLE_CAM
```

## dts/bindings/sdhc/alif,sdio.yaml
```yaml
description: Alif SDIO controller

compatible: "alif,sdio"

include: [sdhc.yaml, pinctrl-device.yaml]

properties:
  reg:
    required: true

  pinctrl-0:
    required: true

  pinctrl-names:
    required: true
```

## samples/drivers/counter/alarm/boards/alif_rtc.conf
```kconfig
# Copyright (c) 2024 Alif Semiconductor
#
# SPDX-License-Identifier: Apache-2.0

CONFIG_COUNTER_SNPS_DW=n
CONFIG_COUNTER_DW_RTC=y
```

## soc/arm/alif_balletto/b1/Kconfig.defconfig.series
```kconfig
# Copyright (c) 2024 Alif Semiconductor
#
# SPDX-License-Identifier: Apache-2.0

if SOC_SERIES_BALLETTO_B1

config SOC_SERIES
	default "b1"

source "soc/arm/alif_balletto/b1/Kconfig.defconfig.b*"

endif # SOC_SERIES_BALLETTO_B1
```

## soc/arm/alif_balletto/b1/Kconfig.series
```kconfig
# Copyright (c) 2024 Alif Semiconductor
#
# SPDX-License-Identifier: Apache-2.0

config SOC_SERIES_BALLETTO_B1
	bool "Alif Balletto B1 MCU Series"
	select ARM
	select SOC_FAMILY_BALLETTO
	select BUILTIN_STACK_GUARD
	help
	  Enable support for Alif Balletto MCU series
```

## soc/arm/alif_balletto/b1/Kconfig.soc
```kconfig
# Copyright (c) 2024 Alif Semiconductor
#
# SPDX-License-Identifier: Apache-2.0

choice
	prompt "Alif Balletto Family Selection"
	depends on SOC_SERIES_BALLETTO_B1

config SOC_B1_DK_RTSS_HE
	bool "SOC_B1_RTSS_HE"
	select RTSS_HE
	select CPU_CORTEX_M55
	select SOC_SERIES_BALLETTO
	select CPU_HAS_ARM_MPU
	select CPU_CORTEX_M_HAS_SYSTICK
	select CPU_HAS_FPU
	select ARMV8_M_DSP
	select ARMV8_1_M_MVEI
	select ARMV8_1_M_MVEF
endchoice

config SOC_SERIES_BALLETTO
	bool "Alif Balletto Series"
```

## soc/arm/alif_balletto/common/Kconfig.soc
```kconfig
# Copyright (c) 2024 Alif Semiconductor
#
# SPDX-License-Identifier: Apache-2.0

config RTSS_HE
	bool "RTSS_HE core"
	help
	  Enable RTSS_HE core.

config HAVE_BLE_802154_LINK_LAYER
	bool
	default y
	help
	  SOC includes BLE and 802.15.4 Link layer system

config HAVE_BLE_HOST_ROM_IMAGE
	bool
	default y
	help
	  ROM image includes BLE host libraries

config HAS_ALIF_SE_SERVICES
	bool
	default y
	help
	  Device has Secure Enclave services

config HAS_ALIF_POWER_MANAGER
	bool
	depends on HAS_ALIF_SE_SERVICES
	default y
	help
	  Device has Alif Power Manager services

config ARM_MHUV2_INIT_PRIORITY
	int "MHUv2 Init priority"
	depends on ARM_MHUV2
	default 40
	help
	  MHUv2 driver initialization priority.

config ALIF_HWSEM_INIT_PRIORITY
	int "HWSEM Init priority"
	depends on ALIF_HWSEM
	default 50
	help
	  Hardware Semaphore driver initialization priority.

config SOC_SUPPORT_ARM_MHUV2
	bool "SoC support communication through Arm MHUv2"
	select IPM
	select ARM_MHUV2
	help
	  SoC support communication through Arm MHUv2

config SPI_DW_ENABLE
	bool
	default y
	depends on SPI
	help
	  Enable Designware SPI driver.
	select HAS_SPI_DW

choice BT_HCI_BUS_TYPE
	default BT_ALIF
endchoice

choice BT_RECV_CONTEXT
	default BT_RECV_BLOCKING
endchoice

# Use HW entropy for seed Xoshiro128 pseudo random generator
choice RNG_GENERATOR_CHOICE
	default XOSHIRO_RANDOM_GENERATOR
endchoice

# Use HW entropy for seed CTR-DRBG
choice CSPRNG_GENERATOR_CHOICE
	default CTR_DRBG_CSPRNG_GENERATOR
endchoice

# Workaround for not being able to have commas in macro arguments
DT_CHOSEN_Z_FLASH := zephyr,flash

config FLASH_SIZE
	default $(dt_chosen_reg_size_int,$(DT_CHOSEN_Z_FLASH),0,K)

config FLASH_BASE_ADDRESS
	default $(dt_chosen_reg_addr_hex,$(DT_CHOSEN_Z_FLASH))
```

## soc/arm/alif_ensemble/common/Kconfig.soc
```kconfig
# Copyright (c) 2024 Alif Semiconductor
#
# SPDX-License-Identifier: Apache-2.0
config RTSS_HE
	bool "RTSS_HE core"
	help
	  Enable RTSS_HE core.

config RTSS_HP
	bool "RTSS_HP core"
	help
	  Enable RTSS_HP core.

config ALIF_HWSEM_INIT_PRIORITY
	int "HWSEM Init priority"
	depends on ALIF_HWSEM
	default 50
	help
	  Hardware Semaphore driver initialization priority.

config SOC_SUPPORT_ARM_MHUV2
	bool "SoC support communication through Arm MHUv2"
	depends on SOC_FAMILY_ENSEMBLE
	select IPM
	select ARM_MHUV2
	help
	  SoC support communication through Arm MHUv2

config SPI_DW_ENABLE
	bool
	default y
	depends on SPI
	help
	  Enable Designware SPI driver.
	select HAS_SPI_DW

config ENSEMBLE_PDM
	bool "Enable PDM in Ensemble family"
	select AUDIO
	select AUDIO_CODEC
	select AUDIO_DMIC
	help
	  Enable PDM in Ensemble family

if COUNTER_SNPS_DW
config LPTIMER0_OUTPUT_TOGGLE
	bool "LPTimer0 Output Toggle"
	help
	  Enable lptimer 0 output toggle.

config LPTIMER0_EXT_CLK_FREQ
	int "LPTimer0 Ext-clock source Frequency value"
	default 0
	help
	  Provide lptimer 0 clock frequency for external clock source.

config LPTIMER1_OUTPUT_TOGGLE
	bool "LPTimer1 Output Toggle"
	help
	  Enable  lptimer 1 output toggle.

config LPTIMER1_EXT_CLK_FREQ
	int "LPTimer1 Ext-clock source Frequency value"
	default 0
	help
	  Provide lptimer 1 clock frequency for external clock source.
endif # COUNTER_SNPS_DW

config  ROM_ITCM
	bool "Link code into internal instruction tightly coupled memory (ITCM)"
	default n if BOOTLOADER_MCUBOOT || MCUBOOT
	default y
	help
	  Enable this to build applications to run from the ITCM.

if ROM_ITCM || !XIP
config FLASH_SIZE
	default $(dt_node_reg_size_int,/soc/itcm@0,0,K)

config FLASH_BASE_ADDRESS
	default $(dt_node_reg_addr_hex,/soc/itcm@0)
endif # ROM_ITCM

if !ROM_ITCM && RTSS_HP && !USE_DT_CODE_PARTITION
config FLASH_LOAD_OFFSET
	default 0x200000
endif

config ROM_START_OFFSET
	default 0x800 if BOOTLOADER_MCUBOOT
```

## soc/arm/alif_ensemble/e3/Kconfig.series
```kconfig
# Copyright (c) 2024 Alif Semiconductor
#
# SPDX-License-Identifier: Apache-2.0

config SOC_SERIES_ENSEMBLE_E3
	bool "Alif Ensemble E3 MCU Series"
	select ARM
	select SOC_FAMILY_ENSEMBLE
	select BUILD_NO_GAP_FILL
	help
	  Enable support for Alif Ensemble MCU and MPU series
```

## soc/arm/alif_ensemble/e7/Kconfig.series
```kconfig
# Copyright (c) 2024 Alif Semiconductor
#
# SPDX-License-Identifier: Apache-2.0

config SOC_SERIES_ENSEMBLE_E7
	bool "Alif Ensemble E7 MCU Series"
	select ARM
	select SOC_FAMILY_ENSEMBLE
	select BUILD_NO_GAP_FILL
	select BUILTIN_STACK_GUARD
	select INIT_ARCH_HW_AT_BOOT
	help
	  Enable support for Alif Ensemble MCU and MPU series
```
