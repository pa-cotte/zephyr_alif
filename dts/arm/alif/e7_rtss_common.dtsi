/* Copyright (c) 2024 Alif Semiconductor
 *
 * SPDX-License-Identifier: Apache-2.0
 */
#include "ensemble_rtss_common.dtsi"

&{/soc} {
	sram0: sram@2000000 {
		compatible = "zephyr,memory-region","mmio-sram";
		reg = <0x02000000 DT_SIZE_K(4096)>;
		zephyr,memory-region = "SRAM0";
	};
	sram1: sram@8000000 {
		compatible = "zephyr,memory-region","mmio-sram";
		reg = <0x08000000 DT_SIZE_K(2560)>;
		zephyr,memory-region = "SRAM1";
	};
};
