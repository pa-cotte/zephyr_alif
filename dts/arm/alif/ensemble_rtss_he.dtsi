/* Copyright (c) 2024 Alif Semiconductor
 *
 * SPDX-License-Identifier: Apache-2.0
 */
#include <arm/armv8.1-m.dtsi>
#include <mem.h>
&{/soc} {
	itcm: itcm@0 {
		compatible = "alif,itcm";
		reg = <0x0 DT_SIZE_K(256)>;
		itcm_global_base = <0x50800000>;
		zephyr,memory-region = "ITCM";
	};
	dtcm: dtcm@20000000 {
		compatible = "alif,dtcm";
		reg = <0x20000000 DT_SIZE_K(256)>;
		dtcm_global_base = <0x58800000>;
		zephyr,memory-region = "DTCM";
	};
};
